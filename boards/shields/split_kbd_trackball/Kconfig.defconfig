## boards/shields/split_kbd_trackball/Kconfig.defconfig
```kconfig
if SHIELD_SPLIT_KBD_TRACKBALL_LEFT

    config ZMK_KEYBOARD_NAME
        default "SKT(Left)"

endif

if SHIELD_SPLIT_KBD_TRACKBALL_RIGHT

    config ZMK_KEYBOARD_NAME
        default "SKT(Right)"

    config ZMK_SPLIT_ROLE_CENTRAL
    	default y

endif

if SHIELD_SPLIT_KBD_TRACKBALL_LEFT || SHIELD_SPLIT_KBD_TRACKBALL_RIGHT

    config ZMK_SPLIT
        default y

endif
```

## boards/shields/split_kbd_trackball/Kconfig.shield
```kconfig
config SHIELD_SPLIT_KBD_TRACKBALL_LEFT
    def_bool $(shields_list_contains,split_kbd_trackball_left)

config SHIELD_SPLIT_KBD_TRACKBALL_RIGHT
    def_bool $(shields_list_contains,split_kbd_trackball_right)
```
